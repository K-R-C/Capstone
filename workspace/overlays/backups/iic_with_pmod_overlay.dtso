/dts-v1/;
/plugin/;
/ {
	fragment@0 {
		target = <&amba>;
		// #address-cells = <1>;
		// #size-cells = <1>;

		__overlay__ {
			#address-cells = <1>;
			#size-cells = <1>;
			
			i2c@40000000 {
				compatible = "xlnx,xps-iic-2.00.a";
				interrupt-parent = <&intc>;
				interrupt-names = "iic2intc_irpt";
				interrupts = <0 29 4>;
				clock-names = "s_axi_aclk";
				clocks = <&clkc 15>;
				reg = <0x40000000 0x200>;
				#address-cells = <1>;
				#size-cells = <0>;

				pmod0@57 {
					compatible = "renesas,isl29501";
					reg = <0x57>;
				};
			};
		};
	};
};
