/dts-v1/;
/plugin/;
/ {
	fragment {
		target = <&pliic0>;


		__overlay__ {
			#address-cells = <1>;
			#size-cells = <1>;

			tof0: pmod0@57 {
				compatible = "renesas,isl29501";
				reg = <0x57>;

			};
		};
	};
};
